## gc/Kconfig
```kconfig
config FEATURE_HAS_GC_LOCK
  bool

# Select Y on here if platform supports optimized GC lock
# in per platform Kconfig file
config FEATURE_HAS_OPTIMIZED_GC_LOCK
  bool
  select FEATURE_HAS_GC_LOCK

config GC_LOCK_USE_POSIX
  bool
  select FEATURE_HAS_GC_LOCK
  # Only enabled if no platform/arch has optimized GC lock
  default y if !FEATURE_HAS_OPTIMIZED_GC_LOCK || GC_LOCK_FORCE_POSIX

menu "GC options"
  config GC_LOCK_FORCE_POSIX
    bool "Force POSIX GC lock"
    depends on FEATURE_HAS_OPTIMIZED_GC_LOCK
    help
      Most of time there no reason to select Y here, as
      platform optimized implementations supports faster
      GC locks than POSIX based implementation.
endmenu
  
  
```

## platform/Kconfig
```kconfig
choice
  prompt "Target platform"
  
  config PLATFORM_POSIX
    bool "POSIX (or in other word, portable only UwU)"
  config PLATFORM_LINUX
    bool "Linux"
endchoice

if PLATFORM_POSIX
source "./posix/Kconfig"
endif

if PLATFORM_LINUX
source "./linux/Kconfig"
endif
```

## platform/linux/Kconfig
```kconfig
config ____ALWAYS_YES_PLATFORM_LINUX
	def_bool y
	select FEATURE_HAS_OPTIMIZED_GC_LOCK
```

## src/api/mods/Kconfig
```kconfig
menu "Mods"
  config MOD_DMA
    bool "Enable DMA mod"
    default n
  
  if MOD_DMA
    source "dma/Kconfig"
  endif
  
  config MOD_DEBUG
    bool "Enable Debug mod"
    default n
    select HOOK
  
  if MOD_DEBUG
    source "debug/Kconfig"
  endif
endmenu
```

## src/api/mods/Kconfig.dma
```kconfig
choice
  prompt "DMA Flavour"
  default MOD_DMA_NATIVE if GC_UNMOVEABLE_DATA
  
  config MOD_DMA_ZERO_COPY
    bool "Zero copy (fastest)"
    depends on GC_UNMOVEABLE_DATA
    help
      Fastest mode with zero overhead of copying data

  # Unavailable yet
  #config MOD_DMA_EMULATED
  #  bool "Emulated (slowest)"
  #  help
  #    Slower implementation of DMA mod by using intermediate
  #    buffer. Works with any configuration
endchoice
```

## src/api/mods/debug/Kconfig.debug
```kconfig
choice
  prompt "Default verbosity"
  default MOD_DEBUG_NORMAL
  
  config MOD_DEBUG_NORMAL
    bool "Normal"
    help
      Warn only
  
  config MOD_DEBUG_VERBOSE
    bool "Verbose"
    help
      Print each API call and return value
  
  config MOD_DEBUG_ULTRA_VERBOSE
    bool "Ultra verbose"
    help
      Print each API call, return value and its
      arguments
endchoice

config MOD_DEBUG_PANIC
  bool "Panic on error"
  help
    Panics by default on invalid API call else print
    warnings

config MOD_DEBUG_ALWAYS_ENABLE
  bool "Always enable"
  help
    Always enable debug mod, enabled implicitly and
    can't be disabled
    
    Note: Due the design some function will always
    be checked regardless whether the mod enabled
    or not (usually the one which don't need valid
    managed heap instance in thread local variable)
```

## src/api/mods/dma/Kconfig
```kconfig
choice
  prompt "DMA Flavour"
  default MOD_DMA_FLAVOUR_ZERO_COPY if HEAP_HAVE_FIXED_DATA_PTR
  
  config MOD_DMA_FLAVOUR_ZERO_COPY
    bool "Zero copy"
    depends on HEAP_HAVE_FIXED_DATA_PTR
    help
      Fastest mode with zero overhead of copying data

  config MOD_DMA_FLAVOUR_COPYING
    bool "Copying"
    help
      Slower implementation of DMA mod by using intermediate
      buffer. Works with any configuration.

endchoice
```

## src/fuzzing/Kconfig
```kconfig
menu Fuzzing
  config FUZZER
    bool
    select MAIN_DISABLED
  
  choice
    prompt "Fuzzer variant"
    depends on !BUILD_OVERRIDE_PROJECT_FLAGS
    
    config FUZZER_NONE
      bool "None"
    
    config FUZZER_LIBFUZZER
      bool "libFuzzer"
      select FUZZER
      help
        When using with ASAN for long time its
        recommended to use fork mode (`-fork=N`) 
        and use `quarantine_size_mb` to avoid
        unbounded RSS growth when there really
        no leaks due ASAN's quarantine
  endchoice
  
  choice
    prompt "Select subsystem to fuzz"
    depends on FUZZER
    
    config FUZZ_SOC
      bool "SOC allocator and deallocator"
    config FUZZ_HEAP
      bool "Heap allocator and deallocator"
    config FUZZ_ROOT_REFS
      bool "Root refs allocator and deallocator"
  endchoice
  
  config FUZZ_SOC_USE_IMPLICIT
    bool "Use soc_* implicit variant"
    depends on FUZZ_SOC
    help
      Currently defautl explicit variant soc_*_explicit avoids looking
      up memory address for a chunk to fuzz on the core code
      more efficiently than trying to fuzz the lookup codes and the core
endmenu
```

## src/gc/Kconfig
```kconfig
menu "GC"
  config GC_UNMOVEABLE_DATA
    def_bool n

  config GC_SEPERATE_THREAD
    bool "Seperate GC thread"
    depends on !DISABLE_THREADS
    default y
    help
      This let main GC part runs on its own thread
      to hopefully improve cache locality and also
      for convenience of watching GC CPU usage for
      main part

  config GC_MARK_MAX_DEPTH
    int "Maximum recursion for marking"
    range 200 10000
    default 200
    help
      Upper bound of recursive mark
  
  config GC_OPTIMIZE_DATA_MOVE
    bool "Optimize move"
    default y if !MEMORY_DEBUG
    depends on HEAP_USE_MALLOC
    select GC_UNMOVEABLE_DATA
    help
      Optimize move so that move consist only moving data pointer
      instead actually do the copy.
      
      May hinder debugging if enabled as raw pointer to dead object
      still points to valid data
endmenu
```

## src/logger/Kconfig
```kconfig
menu "Logger"
  config PERTHREAD_LOG_BUFFER_SHIFT
    int "Per thread log buffer size"
    range 10 12
    help
      Size of per thread buffer in bit shift
      10 => 1 KiB
      11 => 2 KiB
      12 => 4 KiB
  config LOG_BUFFER_SHIFT
    int "Log buffer size"
    range 16 20
    help
      Size of loggee buffer in bit shift
      15 => 32 KiB
      16 => 64 KiB
      17 => 128 KiB
      18 => 256 KiB
      19 => 512 KiB
      20 => 1 MiB
endmenu 
```

## src/memory/Kconfig
```kconfig
menu Memory
  source "Kconfig.soc"
  source "Kconfig.heap"
  
  config MEMORY_DEBUG
    bool "Show options for debugging memory problems"
endmenu

  
```

## src/memory/Kconfig.heap
```kconfig
menu "Heap"
  config HEAP_COMPACTABLE_HEAP
    bool

  # The data ptr is fixed throughout
  # object lifetime, data may be moved
  # but ptr used to accessed it still
  # usable
  config HEAP_HAVE_FIXED_DATA_PTR
    bool

  choice
    prompt "Heap flavour"
    default HEAP_FLAVOUR_MALLOC

    config HEAP_FLAVOUR_SIMPLE
      bool "Simple"
      select HEAP_COMPACTABLE_HEAP
      help
        Simple and capable of heap compaction.
    
    config HEAP_FLAVOUR_MALLOC
      bool "Runtime malloc"
      help
        Plain and simple malloc call. With 0 capability
        of heap compaction.
  endchoice

  if HEAP_FLAVOUR_SIMPLE
  source "heap_simple/Kconfig"
  endif
  
  if HEAP_FLAVOUR_MALLOC
  source "heap_malloc/Kconfig"
  endif
endmenu
```

## src/memory/Kconfig.soc
```kconfig
menu "Small Object Cache"
  config SOC_USE_MALLOC
    bool "Use system malloc instead from cache"
    default y
    help
      This essentially bypass cache and use malloc instead if you are using
      ASAN, MSAN, Valgrind to debug memory problems. Or if your system's malloc
      is faster than SOC for small objects (<8 words) its safe to say Y.
      
      If in doubt, answer N
endmenu
```

## src/memory/heap_malloc/Kconfig
```kconfig
config HEAP_MALLOC_NO_COPY
  bool "Optimize move"
  default y
  select HEAP_HAVE_FIXED_DATA_PTR
  help
    Optimize move so that move consist only moving data pointer
    instead actually do the copy.
    
    May hinder debugging if enabled as raw pointer to dead object
    still points to valid data
```

## src/memory/heap_simple/Kconfig
```kconfig
choice
  prompt "Free block finder type"
  default HEAP_SIMPLE_FREE_BLOCK_BEST_FIT
  
  config HEAP_SIMPLE_FREE_BLOCK_BEST_FIT
    bool "Best fit"
    help
      Slower allocation on slow path (when bump pointer method exhausted)
      but leads to less heap fragmentation 
  
  config HEAP_SIMPLE_FREE_BLOCK_FIRST_FIT
    bool "First fit"
    help
      Faster allocation on slow path (when bump pointer method exhausted)
      but leads to more heap fragmentation
endchoice
```

## src/stacktrace/Kconfig
```kconfig
menu "Stacktrace"
  config ENABLE_STACKTRACE
    bool "Enable stacktrace support"

  config STACKTRACE_HAVE_LIBUNWIND
    def_bool $[[scripts/check_pkgconfig.sh libunwind]]
  config STACKTRACE_HAVE_LIBBACKTRACE
    def_bool $[[scripts/check_linker_lib.sh backtrace]]

  if ENABLE_STACKTRACE
  choice
    prompt "Stacktrace provider"
    
    config STACKTRACE_PROVIDER_LIBBACKTRACE
      bool "libbacktrace"
      depends on STACKTRACE_HAVE_LIBBACKTRACE

    config STACKTRACE_PROVIDER_LIBUNWIND
      bool "libunwind"
      depends on STACKTRACE_HAVE_LIBUNWIND
  endchoice

  config STACKTRACE_USE_DLADDR
    bool "Use dladdr to get function name if debug info unavailable"
  endif
endmenu
```
